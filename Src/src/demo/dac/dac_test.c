/**
 * @file dac_test.c
 * @author Product application department
 * @brief  DAC 模块测试用例，仅供参考
 * @version V1.0
 * @date 2025-02-11
 *
 * @copyright Copyright (c) 2025 China Core Co. Ltd. All Rights Reserved
 *
 */

/**
 * @defgroup Peripherals 外设模块
 * @{
 *
 * @defgroup DAC DAC模块
 * @ingroup Peripherals
 * @{
 */

// 头文件包含
#include "dac_test.h"

// 全局变量定义
#define DAC_CPU_MODE 0
#define DAC_DMA_MODE 1

extern dmac_hdle_t hdma;
extern uint8_t dma_tran_complete ;

const uint8_t bin_data[4096] = {
    0x44,0x01,0x58,0x00,0x93,0xff,0xfe,0x01,0xad,0xfe,0xff,0x02,0xbf,0xfc,0xb4,0x04,
    0x81,0xfb,0xc3,0x05,0x0d,0xfe,0x2c,0x03,0xb2,0x02,0xfa,0xfe,0xc4,0x04,0x5c,0xfd,
    0x5f,0x06,0xd5,0xfb,0xa0,0x0e,0x8d,0xf3,0x29,0x1c,0xb6,0xe5,0xa6,0x24,0x27,0xdd,
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    0x42,0x02,0x9b,0xff,0x05,0x0b,0x19,0xf7,0x70,0x10,0xa0,0xf1,0x8b,0x0a,0x8c,0xf7,
};

// 函数定义

/**
 * @brief DAC 模块 CPU传输测试函数
 * @param buf 待传输数据
 * @param l 待传输数据长度
 */
void dac_cpu_tran_test(uint16_t *buf, uint32_t l)
{
    uint32_t data_s = 0;
    hal_dac_init(LEFTALIGNED_8BITS, TRIGGER_SOFTWARE, DET_ON_RISING, 0);

    while (1)
    {
        hal_dac_senddata(buf[data_s++]);
        if (data_s == l)
        {
            data_s = 0;
        }
    }
}

/**
 * @brief DAC 模块 DMA 中断配置初始化函数
 *
 */
void dac_dma_irqinit(void)
{
    NVIC_Init(3, 1, DMA2_IRQn, 2);
    DMA2_IRQHandler_Callback = hal_dac_irqhandler;
}

/**
 * @brief DAC 模块PIT定时器初始化函数
 * @param rate 采样率
 */
void dac_pit_init(uint32_t rate)
{
    hal_pit32_handler_t hpit32;

    hpit32.instance = PIT2;

    hpit32.init.counter = hal_pit32_calc_counter(g_ips_clk, PIT32_CLK_DIV_1, rate); // 1ms

    hpit32.init.enable_ie = DISABLE;

    hpit32.init.reload = ENABLE;

    hpit32.init.prescaler = PIT32_CLK_DIV_1;

    hpit32.init.run_at_debug = ENABLE;

    hpit32.init.run_at_doze = ENABLE;

    hpit32.init.update_cnt = ENABLE;

    hal_pit32_init(&hpit32);
}

/**
 * @brief DAC 模块 DMA传输测试函数
 * @param buf 待传输数据
 * @param l 待传输数据长度
 * @param freq 采样率
 * @param mul 是否阻塞
 */
void dac_dma_tran_test(uint8_t *buf, uint32_t l, uint32_t freq, uint8_t mul)
{
    hdma.instance = DMAC2;
    hdma.init.channel_num = 0; // HAL_DMACC_CHANNEL_0;

    hal_dmac_deinit(&hdma);

    hdma.init.dst_msize = HAL_DMAC_MSIZE_4;
    hdma.init.src_msize = HAL_DMAC_MSIZE_4;
    hdma.init.src_inc = HAL_DMAC_SINC_INC;
    hdma.init.dst_inc = HAL_DMAC_DINC_NO_CHANGE;
    hdma.init.dst_tr_width = HAL_DMAC_TR_WIDTH_16BITS;
    hdma.init.src_tr_width = HAL_DMAC_TR_WIDTH_16BITS;

    hdma.init.transfer_type = HAL_DMAC_TRANSFERTYPE_M2P_CONTROLLER_DMA;
    hdma.init.peripheral_type = HAL_DMAC2_PERIPHERAL_DAC; // 需要修改
    hdma.init.transfer_lli = HAL_DMAC_LLP_DIS;
    hdma.init.src_addr = (uint32_t)buf;
    hdma.init.dst_addr = (uint32_t)(DAC->DAC_DR);
    hdma.init.transfer_size = l;

    hal_dac_init(LEFTALIGNED_12BITS, TRIGGER_PIT, DET_ON_RISING, 1);
    hal_dmac_init(&hdma);
    dac_dma_irqinit();

    hal_dmac_start_it(&hdma);

    dac_pit_init(freq);

    if (mul)
    {
        // 阻塞式
        while (dma_tran_complete == 0);
    }
}
/**
 * @brief DAC 模块测试示例函数
 * @param
 */
void dac_demo(void)
{
    printf("DAC test\r\n");
#if DAC_CPU_MODE
    uint16_t data_buf[257];

    uint32_t i;

    for (i = 0; i < 256; i++)
    {
        data_buf[i] = i * 16;
    }
    data_buf[256] = 0x0FFF;
    dac_cpu_tran_test(data_buf, 257); // CPU方式

#elif DAC_DMA_MODE
    while (1)
    {
        dac_dma_tran_test((uint8_t *)bin_data, 4090, 44100, 1); // DMA方式
        delayms(1000);
    }
#endif
}



/** @} */  // 结束 DAC 模块分组
/** @} */  // 结束外设模块分组
