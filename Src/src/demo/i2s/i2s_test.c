/**
 * @file i2s_test.c
 * @author Product Application Department
 * @brief I2S 模块测试用例，仅供参考
 * @version V1.0
 * @date 2025-03-06
 *
 * @copyright Copyright (c) 2025 China Core Co. Ltd. All Rights Reserved
 *
 */

/**
 * @defgroup Peripherals 外设模块
 * @{
 *
 * @defgroup I2S I2S模块
 * @ingroup Peripherals
 * @{
 */

// 头文件包含
#include "i2s_test.h"

#define I2S_BF_LEN 0x4000
#define I2S_BIN_LEN 0x200
// 全局变量定义
static i2s_handle_t g_hi2s;

uint16_t i2s_addr[I2S_BF_LEN] __attribute__((section("NO_INIT")));

const uint8_t i2s_bin_data[I2S_BIN_LEN] = {
    0x12,0x34,0x56,0x78,0x11,0x22,0x33,0x44,0x55,0x66,0x77,0x88,0x12,0x34,0x56,0x78,
    0xaa,0x55,0xaa,0x55,0xaa,0x55,0xaa,0x55,0xaa,0x55,0xaa,0x55,0xaa,0x55,0xaa,0x55,
    0x12,0x34,0x56,0x78,0x11,0x22,0x33,0x44,0x55,0x66,0x77,0x88,0x12,0x34,0x56,0x78,
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    0xaa,0x55,0xaa,0x55,0xaa,0x55,0xaa,0x55,0xaa,0x55,0xaa,0x55,0xaa,0x55,0xaa,0x55,
};
// 函数定义

/**
 * @brief I2S初始化
 *
 * @param pi2s I2S句柄
 * @param i2s_mode I2S工作模式
 * @return 
 */
void i2s_test_init(reg_i2s_t *pi2s, i2s_mode_t i2s_mode)
{
    g_hi2s.Instance = pi2s;
    g_hi2s.Init.Mode = i2s_mode;
    g_hi2s.Init.MclkPrescaler = 15; // Mclk = sysclk / (MclkPrescaler + 1)
    g_hi2s.Init.SclkPrescaler = 15; // Sclk = sysclk / (SclkPrescaler + 1)
    g_hi2s.Init.LrcPrescaler = 128; // Lrck = Sclk / LrcPrescaler / 2
    hal_i2s_init(&g_hi2s);
    g_hi2s.State = HAL_I2S_STATE_READY;
}

/**
 * @brief I2S 模块CPU传输测试测试函数
 *
 */
void i2s_cpu_transfer_test()
{
    i2s_test_init(I2S1, I2S_MODE_PLAY);

    if (hal_i2s_mastertransmit(&g_hi2s, (uint8_t *)i2s_bin_data, I2S_BIN_LEN, 0) == STATUS_OK)
    {
        printf("I2S transfer test success!\r\n");
    }
    else
    {
        printf("I2S DMA transfer test fail!\r\n");
    }
}

/**
 * @brief I2S 模块CPU接收测试函数
 *
 */
void i2s_cpu_receive_test()
{
    i2s_test_init(I2S1, I2S_MODE_RECORD);

    if (hal_i2s_masterreceive(&g_hi2s, (uint8_t *)i2s_addr, I2S_BF_LEN, 0) == STATUS_OK)
    {
        printf("I2S receive test success!\r\n");
    }
    else
    {
        printf("I2S DMA receive test fail!\r\n");
    }
}

/**
 * @brief I2S 模块DMA传输测试函数
 *
 */
void i2s_dma_transfer_test()
{
    i2s_test_init(I2S1, I2S_MODE_PLAY);

    if (hal_i2s_dmactx(0, I2S1, (uint8_t *)i2s_bin_data, I2S_BIN_LEN) == STATUS_OK)
    {
        printf("I2S DMA transfer test success!\r\n");
    }
    else
    {
        printf("I2S DMA transfer test fail!\r\n");
    }
}

/**
 * @brief I2S 模块DMA接收测试函数
 *
 */
void i2s_dma_receive_test()
{
    i2s_test_init(I2S1, I2S_MODE_RECORD);

    if (hal_i2s_dmacrx(0, I2S1, (uint8_t *)i2s_addr, I2S_BF_LEN) == STATUS_OK)
    {
        printf("I2S DMA receive test success!\r\n");
    }
    else
    {
        printf("I2S DMA receive test fail!\r\n");
    }
}

/**
 * @brief I2S 模块测试示例函数
 *
 */
void i2s_demo()
{
    SwitchPinFunction(PHY_TXD1_FUN, I2S1_MCLK_FUN);
    SwitchPinFunction(PHY_TXD0_FUN, I2S1_SCLK_FUN);
    SwitchPinFunction(PHY_MDIO_FUN, I2S1_LRCK_FUN);
    SwitchPinFunction(PHY_TXEN_FUN, I2S1_SD_FUN);
    // i2s_cpu_transfer_test();
    // i2s_cpu_receive_test();

    i2s_dma_transfer_test();
    // i2s_dma_receive_test();
}

/** @} */  // 结束 I2S 模块分组
/** @} */  // 结束外设模块分组
